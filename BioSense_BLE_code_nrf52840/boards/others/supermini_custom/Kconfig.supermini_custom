## BioSense_BLE_code_nrf52840/boards/others/supermini_custom/board.yml
```yaml
board:
  name: supermini_custom
  full_name: SuperMini Custom nRF52840
  vendor: others
  socs:
    - name: nrf52840
```
